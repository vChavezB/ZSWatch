/*
 * Copyright (c) 2023 Victor Chavez
 *
 * SPDX-License-Identifier: GPL-3.0-or-later
 */
/* Disable most of the peripherals
    and drivers as mcuboot 
    does not require them.
*/
&i2c1 {
    status = "disabled";    
};

&i2c2 {
    status = "disabled";
};

&spi4{
    status = "disabled";
};